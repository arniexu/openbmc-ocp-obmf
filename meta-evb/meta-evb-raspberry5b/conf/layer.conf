## meta-evb/meta-evb-raspberry5b/conf/layer.conf
```bitbake
BBPATH .= ":${LAYERDIR}"

BBFILE_COLLECTIONS += "evb_raspberry5b"
BBFILE_PATTERN_evb_raspberry5b = "^${LAYERDIR}/"
BBFILE_PATTERN_IGNORE_EMPTY_evb_raspberry5b = "1"

LAYERSERIES_COMPAT_evb_raspberry5b = "whinlatter walnascar"
```

## meta-evb/meta-evb-raspberrypi/conf/layer.conf
```bitbake
BBPATH .= ":${LAYERDIR}"

BBFILE_COLLECTIONS += "evb_raspberrypi"
BBFILE_PATTERN_evb_raspberrypi = "^${LAYERDIR}/"
BBFILE_PATTERN_IGNORE_EMPTY_evb_raspberrypi = "1"

LAYERSERIES_COMPAT_evb_raspberrypi = "whinlatter walnascar"
```
